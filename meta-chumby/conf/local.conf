## meta-chumby/conf/local.conf
```bitbake
# Don't fetch things from Angstrom
#SOURCE_MIRROR_URL = "ftp://ax010-bob64/sources"
#INHERIT += "own-mirrors"

# Where tempfiles (and the resulting image) go
TMPDIR = "${TOPDIR}/output-${DISTRO}-${DISTRO_PR}"

# Use this to specify where BitBake should place the downloaded sources into
DL_DIR = "${TOPDIR}/sources"


# Delete the line below. Then specify which .bb files to consider for
# your build. Typically this will be something like BBFILES = "/path/to/openembedded/recipes/*/*.bb"
BBFILES := "${TOPDIR}/meta-chumby/recipes/*/*.bb"
BBFILES += "${TOPDIR}/openembedded/recipes/*/*.bb"


# Use the BBMASK below to instruct BitBake to _NOT_ consider some .bb files
# This is a regular expression, so be sure to get your parenthesis balanced.
BBMASK = ""


# Uncomment this if you want to use a prebuilt toolchain. You will need to
# provide packages for toolchain and additional libraries yourself. You also
# have to set PATH in your environment to make sure BitBake finds additional
# binaries.
# ASSUME_PROVIDED += "virtual/${TARGET_PREFIX}gcc virtual/libc"



# Select between multiple alternative providers, if more than one is eligible.
PREFERRED_PROVIDERS = "virtual/qte:qte virtual/libqpe:libqpe-opie"
PREFERRED_PROVIDERS += " virtual/libsdl:libsdl-x11"
PREFERRED_PROVIDERS += " virtual/${TARGET_PREFIX}gcc-initial:gcc-cross-initial"
PREFERRED_PROVIDERS += " virtual/${TARGET_PREFIX}gcc-intermediate:gcc-cross-intermediate"
PREFERRED_PROVIDERS += " virtual/${TARGET_PREFIX}gcc:gcc-cross"
PREFERRED_PROVIDERS += " virtual/${TARGET_PREFIX}g++:gcc-cross"


# If ENABLE_BINARY_LOCALE_GENERATION is set to "1", you can limit locales
# generated to the list provided by GLIBC_GENERATE_LOCALES. This is huge
# time-savior for developmental builds. Format: list of locale.encoding pairs
# with spaces as separators.
#ENABLE_BINARY_LOCALE_GENERATION = "0"
#GLIBC_GENERATE_LOCALES = "en_US.UTF-8 en_GB.UTF-8 de_DE.UTF-8"
#ASSUME_PROVIDED += "qemu-native"


# Uncomment this if you want to keep the temporary rootfs
# diretory, this can be useful during development.
# (Note that this rootfs is NOT usuable as NFS export.)
# IMAGE_KEEPROOTFS = "1"


# Uncomment these two if you want BitBake to build images useful for debugging. 
# Note that INHIBIT_PACKAGE_STRIP needs a package format to be defined.
# Also note that OE now produces -dbg packages which contain debugging symbols.
# DEBUG_BUILD = "1"
# INHIBIT_PACKAGE_STRIP = "1"


# Uncomment these to build a package such that you can use gprof to profile it.
# NOTE: This will only work with 'linux' targets, not
# 'linux-uclibc', as uClibc doesn't provide the necessary
# object files.  Also, don't build glibc itself with these
# flags, or it'll fail to build.
#
# PROFILE_OPTIMIZATION = "-pg"
# SELECTED_OPTIMIZATION = "${PROFILE_OPTIMIZATION}"
# LDFLAGS =+ "-pg"


# Have BitBake emit the log if a build fails.
BBINCLUDELOGS = "yes"



# Inherit devshell to be able to go into a development shell environment.
INHERIT += "devshell"
TERMCMD = "${SCREEN_TERMCMD}"
TERMCMDRUN = "${SCREEN_TERMCMDRUN}"



# Remove build directories after building them
INHERIT += "rm_work"

# Allow packages in our overlay to add to existing packages in openembedded
INHERIT += "amend"


# Add the required image file system types below. Valid are 
# jffs2, tar(.gz|bz2), cpio(.gz), cramfs, ext2(.gz), ext3(.gz)
# squashfs, squashfs-lzma
IMAGE_FSTYPES = "ext3.gz"



# This allows make to spawn mutliple processes to take advantage of multiple 
# processors. Useful on SMP machines.
PARALLEL_MAKE = "-j 2"


# Bitbake can do multiple jobs in parallel: Its a good idea make use of 
# all available resources: e.g. to download sources while some other
# piece of software is compiled.
BB_NUMBER_THREADS = "3"
```

## meta-chumby/conf/machine/chumby-falconwing.conf
```bitbake
#@TYPE: Machine
#@Name: chumby Falconwing i.MX233-based boards
#@DESCRIPTION: Machine configuration for chumby Falconwing platform

TARGET_ARCH = "arm"

MACHINE_GUI_CLASS = "smallscreen"
MACHINE_DISPLAY_WIDTH_PIXELS = "720"
MACHINE_DISPLAY_HEIGHT_PIXELS = "480"

PREFERRED_PROVIDER_virtual/kernel = "linux-falconwing"
PREFERRED_PROVIDER_virtual/bootloader = "chumby-falconwing-bootimage"

require conf/machine/include/tune-arm926ejs.inc

MACHINE_EXTRA_RDEPENDS += " \
    chumby-udev-rules \
    rt73-firmware \
    config-util regutil-${CNPLATFORM} \
"


# used by sysvinit_2
SERIAL_CONSOLE = "115200 ttyAM0"

MACHINE_FEATURES = "kernel26 usbhost touchscreen ext2 ext3 vfat keyboard alsa"

# ROOTFS is in terms of kilobytes.
IMAGE_ROOTFS_SIZE = "450000"

require conf/machine/include/chumby.inc
```

## meta-chumby/conf/machine/chumby-silvermoon.conf
```bitbake
#@TYPE: Machine
#@Name: Silvermoon Armada 100 Development Platform
#@DESCRIPTION: Machine configuration for chumby Silvermoon board

TARGET_ARCH = "arm"

MACHINE_GUI_CLASS = "bigscreen"
MACHINE_CLASS = "bigscreen"
MACHINE_DISPLAY_WIDTH_PIXELS = "800"
MACHINE_DISPLAY_HEIGHT_PIXELS = "600"
MACHINE_FEATURES = "kernel26 usbhost touchscreen ext2 ext3 vfat keyboard alsa iwmmxt wifi"
MACHINE_TASK_PROVIDER 		= "task-base"
MACHINE_ESSENTIAL_EXTRA_RDEPENDS = "u-boot-2009.07-silvermoon"
MACHINE_HAS_CRYPTOPROCESSOR = "1"

PREFERRED_PROVIDER_virtual/kernel = "linux-silvermoon"
PREFERRED_PROVIDER_virtual/bootloader = "u-boot-2009.07-silvermoon"
PREFERRED_PROVIDER_chumby-blobs = "chumby-blobs-silvermoon"

UBOOT_MACHINE = "aspenite_config"
BOOTIMAGE_NAME = "u-boot-${MACHINE}.bin"


MACHINE_EXTRA_RDEPENDS += " \
    sd8686-firmware \
    sd8686 \
    chumby-udev-rules \
"

MACHINE_EXTRA_INSTALL = "\
    sd8686-silvermoon \
    chumby-udev-rules-silvermoon \
"

MACHINE_EXTRA_RRECOMMENDS = " kernel-modules"

INITRAMFS_IMAGE = ""

module_autoload_silvermoon-tsb = "silvermoon-tsb"

# used by sysvinit_2
SERIAL_CONSOLE = "115200 ttyS0"

# Match current Silvermoon devices
IMAGE_ROOTFS_SIZE = "400000"


require conf/machine/include/tune-xscale.inc
require conf/machine/include/chumby.inc
```

## meta-chumby/conf/machine/include/chumby.inc
```bitbake
CNPLATFORM = "${@bb.data.getVar('MACHINE', d, 1).replace('chumby-', '')}"

IMAGE_FSTYPES = "ext3"
IMAGE_CMD_ext3 = "genext2fs -N 50000 -b ${ROOTFS_SIZE} -d ${IMAGE_ROOTFS} ${DEPLOY_DIR_IMAGE}/${IMAGE_NAME}.rootfs.ext3 ${EXTRA_IMAGECMD}; tune2fs -j ${DEPLOY_DIR_IMAGE}/${IMAGE_NAME}.rootfs.ext3"
EXTRA_IMAGEDEPENDS += "makedisk-native config-util-native virtual/kernel virtual/bootloader chumby-blobs virtual/chumby-bootimage"
MACHINE_POSTPROCESS_COMMAND = "chumby_make_rom"

chumby_make_rom () {

    # Make full boot ROM
    install -d ${DEPLOY_DIR_IMAGE}
    makedisk -o ${DEPLOY_DIR_IMAGE}/rom-${MACHINE}-${IMAGE_BASENAME}.img \
             -a 16M:0x53:${DEPLOY_DIR_IMAGE}/boot-${MACHINE}.bin \
             -a ${ROOTFS_SIZE}k:0x83:${DEPLOY_DIR_IMAGE}/${IMAGE_LINK_NAME}.ext3
    #package_stagefile_shell ${DEPLOY_DIR_IMAGE}/rom-${MACHINE}-${IMAGE_BASENAME}.img
}
```
